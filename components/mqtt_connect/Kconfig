## components/mqtt_connect/Kconfig
```kconfig
menu "Mqtt Configurations"
    config EXAMPLE_MQTT_Broker
        string "URI of Broker"
        default "mqtt://193.174.24.220:1883"

    config EXAMPLE_MQTT_TOPIC_FIRST
        string "First Topic you want to subscribe to"
        default "monitoring-system/sound_sensor"

    config EXAMPLE_MQTT_TOPIC_SECOND
        string "First Topic you want to subscribe to"
        default "monitoring-system/motion_sensor"
endmenu
```

## components/whatsapp_messaging_http/Kconfig
```kconfig
menu "Whatsapp Messaging Configurations"
    config API_KEY
        string "your api key for callmeBot"
        default ""

    config WHATSAPP_NUM
        string "your whatsapp number"
        default ""

    config WHATSAPP_MESSAGE
        string "the message you want to send to your phonrn number"
        default ""
endmenu
```

## src/Kconfig.projbuild
```kconfig
menu "Monitoring Project Configuration"
    
    config MESSAGE_DELAY_WHATSAPP
    int "Delay between sending whatsapp messages"
    range 60000 300000
    default 60000
    help
        delay between whatsapp messages, from 60000ms to 300000ms

    config MESSAGE_DELAY_BUZZER
    int "Delay between sending whatsapp messages"
    range 20000 300000
    default 20000
    help
        delay between buzzer alarm, from 20000ms to 300000ms

endmenu
```
